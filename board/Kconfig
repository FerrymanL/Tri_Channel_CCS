## board/Kconfig
```kconfig
menu "Hardware Drivers Config"

menu "Onboard Peripheral Drivers"

endmenu

menu "On-chip Peripheral Drivers"

    config BSP_USING_GPIO
        bool "Enable GPIO"
        select RT_USING_PIN
        default y

    menuconfig BSP_USING_UART
        bool "Enable UART"
        default y
        select RT_USING_SERIAL
        if BSP_USING_UART
            config BSP_STM32_UART_V1_TX_TIMEOUT
                int "UART TX timeout"
                default 2000
                depends on RT_USING_SERIAL_V1

            menuconfig BSP_USING_UART1
                bool "Enable UART1"
                default y
                if BSP_USING_UART1
                    config BSP_UART1_RX_USING_DMA
                        bool "Enable UART1 RX DMA"
                        depends on BSP_USING_UART1 && RT_SERIAL_USING_DMA
                        default n

                    config BSP_UART1_TX_USING_DMA
                        bool "Enable UART1 TX DMA"
                        depends on BSP_USING_UART1 && RT_SERIAL_USING_DMA
                        default n

                    config BSP_UART1_RX_BUFSIZE
                        int "Set UART1 RX buffer size"
                        range 64 65535
                        depends on RT_USING_SERIAL_V2
                        default 256

                    config BSP_UART1_TX_BUFSIZE
                        int "Set UART1 TX buffer size"
                        range 0 65535
                        depends on RT_USING_SERIAL_V2
                        default 0

                    config BSP_UART1_DMA_PING_BUFSIZE
                        int "Set UART1 RX DMA ping-pong buffer size"
                        range 32 65535
                        depends on RT_USING_SERIAL_V2 && BSP_UART1_RX_USING_DMA
                        default 64
                endif

                menuconfig BSP_USING_UART3
                bool "Enable UART3"
                default y
                if BSP_USING_UART3
                    config BSP_UART3_RX_USING_DMA
                        bool "Enable UART3 RX DMA"
                        depends on BSP_USING_UART3 && RT_SERIAL_USING_DMA
                        default n

                    config BSP_UART3_TX_USING_DMA
                        bool "Enable UART3 TX DMA"
                        depends on BSP_USING_UART3 && RT_SERIAL_USING_DMA
                        default n

                    config BSP_UART3_RX_BUFSIZE
                        int "Set UART3 RX buffer size"
                        range 64 65535
                        depends on RT_USING_SERIAL_V2
                        default 256

                    config BSP_UART3_TX_BUFSIZE
                        int "Set UART3 TX buffer size"
                        range 0 65535
                        depends on RT_USING_SERIAL_V2
                        default 0

                    config BSP_UART3_DMA_PING_BUFSIZE
                        int "Set UART3 RX DMA ping-pong buffer size"
                        range 32 65535
                        depends on RT_USING_SERIAL_V2 && BSP_UART3_RX_USING_DMA
                        default 64
                endif
        endif

    menuconfig BSP_USING_SPI
        bool "Enable SPI BUS"
        default y
        select RT_USING_SPI
        if BSP_USING_SPI
            menuconfig BSP_USING_SPI1
                bool "Enable SPI1 BUS"
                default y
                if BSP_USING_SPI1
                    config BSP_SPI1_TX_USING_DMA
                        bool "Enable SPI1 TX DMA"
                        depends on BSP_USING_SPI1
                        default n

                    config BSP_SPI1_RX_USING_DMA
                        bool "Enable SPI1 RX DMA"
                        depends on BSP_USING_SPI1
                        select BSP_SPI1_TX_USING_DMA
                        default n
                endif

            menuconfig BSP_USING_SPI2
                bool "Enable SPI2 BUS"
                default y
                if BSP_USING_SPI2
                    config BSP_SPI2_TX_USING_DMA
                        bool "Enable SPI2 TX DMA"
                        depends on BSP_USING_SPI2
                        default n

                    config BSP_SPI2_RX_USING_DMA
                        bool "Enable SPI2 RX DMA"
                        depends on BSP_USING_SPI2
                        select BSP_SPI2_TX_USING_DMA
                        default n
                endif

            menuconfig BSP_USING_SPI3
                bool "Enable SPI3 BUS"
                default y
                if BSP_USING_SPI3
                    config BSP_SPI3_TX_USING_DMA
                        bool "Enable SPI3 TX DMA"
                        depends on BSP_USING_SPI3
                        default n

                    config BSP_SPI3_RX_USING_DMA
                        bool "Enable SPI3 RX DMA"
                        depends on BSP_USING_SPI3
                        select BSP_SPI3_TX_USING_DMA
                        default n
                endif
        endif
    source "$(BSP_DIR)/libraries/HAL_Drivers/drivers/Kconfig"

endmenu

menu "Board extended module Drivers"

endmenu

endmenu
```
